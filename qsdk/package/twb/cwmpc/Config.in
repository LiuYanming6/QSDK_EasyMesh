## qsdk/package/twb/cwmpc/Config.in
```kconfig
menu "Configuration"
        depends on PACKAGE_cwmpc

config CWMPC_AUTO_SECRET
        bool
        prompt "Enable auto secret"
        help
                Enable auto secret

endmenu
```
